## package/cicd/Config.in
```kconfig
config BR2_PACKAGE_CICD
	bool "cicd"
	select BR2_PACKAGE_BOOST
	select BR2_PACKAGE_BOOST_THREAD
	select BR2_PACKAGE_MESA3D
	select BR2_PACKAGE_MESA3D_GALLIUM_DRIVER_PANFROST
	select BR2_PACKAGE_MESA3D_OPENGL_EGL
	select BR2_PACKAGE_MESA3D_OPENGL_ES
	select BR2_PACKAGE_QT5
	select BR2_PACKAGE_QT5BASE_EGLFS
	select BR2_PACKAGE_QT5BASE_FONTCONFIG
	select BR2_PACKAGE_QT5BASE_GIF
	select BR2_PACKAGE_QT5BASE_GUI
	select BR2_PACKAGE_QT5BASE_HARFBUZZ
	select BR2_PACKAGE_QT5BASE_JPEG
	select BR2_PACKAGE_QT5BASE_LINUXFB
	select BR2_PACKAGE_QT5BASE_PNG
	select BR2_PACKAGE_QT5BASE_TSLIB
	select BR2_PACKAGE_QT5GRAPHICALEFFECTS
	select BR2_PACKAGE_QT5IMAGEFORMATS
	select BR2_PACKAGE_QT5MULTIMEDIA
	select BR2_PACKAGE_QT5QUICKCONTROLS
	select BR2_PACKAGE_QT5QUICKCONTROLS2
	select BR2_PACKAGE_QT5SERIALPORT
	select BR2_PACKAGE_QT5SVG
	select BR2_PACKAGE_SPDLOG
	help
	 Temporary package for testing CI/CD and Sapus SPO
```
