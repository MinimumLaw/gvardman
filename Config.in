## package/orpheus/Config.in
```kconfig
config BR2_PACKAGE_ORPHEUS
	bool "ORPHEUS SPO"
	help
	  Required for Orphey-M device
```

## package/rk3399pro-blobs/Config.in
```kconfig
config BR2_PACKAGE_RK3399PRO_BLOBS
	bool "Binary components for Firefly RK3399Pro board"
	help
	  We need some binary files for DDR init and initial boot procedure
```
